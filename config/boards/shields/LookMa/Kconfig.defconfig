## config/boards/shields/LookMa/Kconfig.defconfig
```kconfig
if SHIELD_LOOKMA_LEFT

config ZMK_KEYBOARD_NAME
    default "LookMa"
config ZMK_SPLIT_BLE_ROLE_CENTRAL
    default y

endif

if SHIELD_LOOKMA_LEFT || SHIELD_LOOKMA_RIGHT

config ZMK_SPLIT
    default y

endif
```

## config/boards/shields/LookMa/Kconfig.shield
```kconfig
config SHIELD_LOOKMA_LEFT
    def_bool $(shields_list_contains,LookMa_left)
    CONFIG_ZMK_SPLIT_ROLE_CENTRAL=y
config SHIELD_LOOKMA_RIGHT
    def_bool $(shields_list_contains,LookMa_right)
```

## config/west.yml
```yaml
manifest:
  remotes:
    - name: zmkfirmware
      url-base: https://github.com/zmkfirmware
    # Additional modules containing boards/shields/custom code can be listed here as well
    # See https://docs.zephyrproject.org/3.2.0/develop/west/manifest.html#projects
  projects:
    - name: zmk
      remote: zmkfirmware
      revision: v0.2
      import: app/west.yml
  self:
    path: config
    
manifest:
  remotes:
      # zmk official
    - name: zmkfirmware
      url-base: https://github.com/zmkfirmware
    - name: gpeye                         #new entry
      url-base: https://github.com/GPeye  #new entry
  projects:
    - name: zmk
      remote: zmkfirmware
      revision: v0.2
      import: app/west.yml
    - name: hammerbeam-slideshow          #new entry
      remote: gpeye                       #new entry
      revision: main                    #new entry
  self:
    path: config
```
